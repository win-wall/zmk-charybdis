/*
 * Copyright (c) 2020 The ZMK Contributors
 *
 * SPDX-License-Identifier: MIT
 */

#include <dt-bindings/led/led.h>
#include <dt-bindings/zmk/mouse.h>
#include <behaviors/mouse_keys.dtsi>
#include <input/processors.dtsi>
#include <dt-bindings/zmk/behaviors.h>
#include "zmk-helpers/helper.h"
#include "zmk-helpers/key-labels/charybdisT.h"
#include <behaviors/num_word.dtsi>
#include <behaviors.dtsi>
#include <dt-bindings/zmk/bt.h>
#include <dt-bindings/zmk/keys.h>
#include <dt-bindings/zmk/outputs.h>
#include <dt-bindings/zmk/pointing.h>
#include <dt-bindings/zmk/rgb.h>
#define KEYS_L LN0 LN1 LN2 LN3 LN4 LN5 LT0 LT1 LT2 LT3 LT4 LT5 LM0 LM1 LM2 LM3 LM4 LM5 LB0 LB1 LB2 LB3 LB4 LB5 LF0 LF2 LF3 LF4 LF5 
#define KEYS_R RN0 RN1 RN2 RN3 RN4 RN5 RT0 RT1 RT2 RT3 RT4 RT5 RM0 RM1 RM2 RM3 RM4 RM5 RB0 RB1 RB2 RB3 RB4 RB5 RF0 RF2 RF3 RF4 RF5 
#define THUMBS LH0 LH1 LH2 LH3 RH0 RH1 RH2 RH3                                            // thumbs
#define NUM 2
#define QUICK_TAP_MS 175


&sk {
  release-after-ms = <900>;
  quick-release;
};

&sl { // Allow sticky mods to chord across sticky layers.
  ignore-modifiers;
};

&lt {
  flavor = "balanced";
  tapping-term-ms = <200>;
  quick-tap-ms = <QUICK_TAP_MS>;
};

#define MAKE_HRM(NAME, HOLD, TAP, TRIGGER_POS)                                 \
  ZMK_HOLD_TAP(NAME, bindings = <HOLD>, <TAP>; flavor = "balanced";            \
               tapping-term-ms = <280>; quick-tap-ms = <QUICK_TAP_MS>;         \
               require-prior-idle-ms = <150>; hold-trigger-on-release;         \
               hold-trigger-key-positions = <TRIGGER_POS>;)
MAKE_HRM(hml, &kp, &kp, KEYS_R THUMBS) // Left-hand HRMs.
MAKE_HRM(hmr, &kp, &kp, KEYS_L THUMBS) // Right-hand HRMs.

// Hack: Make HRM combos tap-only (cf, ZMK issue #544).
#define ZMK_COMBO_8(NAME, TAP, POS, LAYERS, COMBO_MS, IDLE_MS, HOLD, SIDE)     \
  MAKE_HRM(hm_combo_##NAME, &kp, TAP, SIDE THUMBS)                             \
  ZMK_COMBO_6(NAME, &hm_combo_##NAME HOLD 0, POS, LAYERS, COMBO_MS, IDLE_MS)

/* Nav cluster */

// Trigger tap-action on all interrupts.
#define MT_CORE                                                                \
  flavor = "tap-preferred";                                                    \
  tapping-term-ms = <220>;                                                     \
  quick-tap-ms = <220>;                                                        \
  hold-trigger-key-positions = <0>;

&mt { MT_CORE };

ZMK_HOLD_TAP(mt_home, bindings = <&masked_home>, <&kp>; MT_CORE)
ZMK_HOLD_TAP(mt_end, bindings = <&masked_end>, <&kp>; MT_CORE)

#define NAV_LEFT  &mt_home 0   LEFT  // Tap: left  | Long-tap: start of line.
#define NAV_RIGHT &mt_end 0    RIGHT // Tap: right | Long-tap: end   of line.
#define NAV_UP    &mt LC(HOME) UP    // Tap: up    | Long-tap: start of doc.
#define NAV_DOWN  &mt LC(END)  DOWN  // Tap: down  | Long-tap: end   of doc.
#define NAV_BSPC  &mt LC(BSPC) BSPC  // Tap: bspc  | Long-tap: delete word bwd.
#define NAV_DEL   &mt LC(DEL)  DEL   // Tap: del   | Long-tap: delete word fwd.

// Mask CTRL on left/right hold to avoid accidental jumps to start/end of doc.
#define MASK_MODS(NAME, MODS, BINDING)                                         \
  ZMK_MOD_MORPH(NAME, bindings = <BINDING>, <BINDING>; mods = <MODS>;)

MASK_MODS(masked_home, (MOD_LCTL), &kp HOME)
MASK_MODS(masked_end,  (MOD_LCTL), &kp END)

/* Magic-shift & auto-layers */
/* Nav cluster */

// Trigger tap-action on all interrupts.
#define MT_CORE                                                                \
  flavor = "tap-preferred";                                                    \
  tapping-term-ms = <220>;                                                     \
  quick-tap-ms = <220>;                                                        \
  hold-trigger-key-positions = <0>;

&mt { MT_CORE };

ZMK_HOLD_TAP(mt_home, bindings = <&masked_home>, <&kp>; MT_CORE)
ZMK_HOLD_TAP(mt_end, bindings = <&masked_end>, <&kp>; MT_CORE)

#define NAV_LEFT  &mt_home 0   LEFT  // Tap: left  | Long-tap: start of line.
#define NAV_RIGHT &mt_end 0    RIGHT // Tap: right | Long-tap: end   of line.
#define NAV_UP    &mt LC(HOME) UP    // Tap: up    | Long-tap: start of doc.
#define NAV_DOWN  &mt LC(END)  DOWN  // Tap: down  | Long-tap: end   of doc.
#define NAV_BSPC  &mt LC(BSPC) BSPC  // Tap: bspc  | Long-tap: delete word bwd.
#define NAV_DEL   &mt LC(DEL)  DEL   // Tap: del   | Long-tap: delete word fwd.

// Mask CTRL on left/right hold to avoid accidental jumps to start/end of doc.
#define MASK_MODS(NAME, MODS, BINDING)                                         \
  ZMK_MOD_MORPH(NAME, bindings = <BINDING>, <BINDING>; mods = <MODS>;)

MASK_MODS(masked_home, (MOD_LCTL), &kp HOME)
MASK_MODS(masked_end,  (MOD_LCTL), &kp END)

// Tap: num-word | double-tap: sticky num-layer | Hold: num-layer.
#define SMART_NUM &smart_num NUM 0
ZMK_HOLD_TAP(smart_num, bindings = <&mo>, <&num_dance>; flavor = "balanced";
             tapping-term-ms = <200>; quick-tap-ms = <QUICK_TAP_MS>;)
ZMK_TAP_DANCE(num_dance, bindings = <&num_word NUM>, <&sl NUM>;
              tapping-term-ms = <200>;)

/ {
    /* adjust cooldown waiting period for mouse key layer after activated */

    behaviors {
        my_mt: my_mod_tap {
            compatible = "zmk,behavior-hold-tap";
            bindings = <&mo>, <&kp>;

            flavor = "tap-preferred";
            tapping-term-ms = <200>;
            display-name = "My-Mod-Tap";
            #binding-cells = <2>;
        };
    };

    ib_toggle_layer: ib_toggle_layer {
        compatible = "zmk,input-behavior-tog-layer";
        #binding-cells = <1>;
        time-to-live-ms = <2000>;
    };


    combos {
        compatible = "zmk,combos";

        e_insert_link {
            bindings = <&insertLink>;
            key-positions = <13 14>;
        };

        e-org-find {
            bindings = <&insertOrgFind>;
            key-positions = <14 15>;
        };

        e-org-insert {
            bindings = <&insertOrg>;
            key-positions = <15 16>;
        };

        e-buffer-list {
            bindings = <&e_list_buffer>;
            key-positions = <15 17>;
        };

        tab {
            bindings = <&kp TAB>;
            key-positions = <27 28>;
        };

        shift-shift {
            bindings = <&kp LS(LEFT_SHIFT)>;
            key-positions = <26 27>;
        };

        i-find-all {
            bindings = <&kp LC(LS(F))>;
            key-positions = <25 26>;
        };

        i-m-find-all {
            bindings = <&kp LG(LS(F))>;
            key-positions = <25 26>;
            layers = <1>;
        };

        i-setting {
            bindings = <&kp LC(LA(S))>;
            key-positions = <25 26 27>;
        };

        i-m-setting {
            bindings = <&kp LG(COMMA)>;
            key-positions = <25 26 27>;
            layers = <1>;
        };

        c-s-t {
            bindings = <&kp LC(LS(T))>;
            key-positions = <26 27 28>;
        };

        m-c-s-t {
            bindings = <&kp LG(LS(T))>;
            key-positions = <26 27 28>;
            layers = <1>;
        };

        c-a-s-s {
            bindings = <&kp LC(LA(LS(S)))>;
            key-positions = <25 26 27 28>;
        };

        i-m-project-structure {
            bindings = <&kp LG(SEMICOLON)>;
            key-positions = <25 26 27 28>;
            layers = <1>;
        };

        copy {
            bindings = <&kp LC(C)>;
            key-positions = <38 39>;
        };

        paste {
            bindings = <&kp LC(V)>;
            key-positions = <39 40>;
        };

        shift-copy {
            bindings = <&kp LC(LS(C))>;
            key-positions = <38 39 37>;
        };

        shift-paste {
            bindings = <&kp LC(LS(V))>;
            key-positions = <38 39 40>;
        };

        enter-1 {
            bindings = <&kp ENTER>;
            key-positions = <50 51>;
        };

        bang {
            bindings = <&kp EXCLAMATION>;
            key-positions = <13 25>;
        };

        at-sign {
            bindings = <&kp AT_SIGN>;
            key-positions = <14 26>;
        };

        hash {
            bindings = <&kp HASH>;
            key-positions = <15 27>;
        };

        dollar-sign {
            bindings = <&kp DOLLAR>;
            key-positions = <16 28>;
        };

        percent {
            bindings = <&kp PERCENT>;
            key-positions = <17 29>;
        };

        caret {
            bindings = <&kp CARET>;
            key-positions = <25 37>;
        };

        ampersand {
            bindings = <&kp AMPERSAND>;
            key-positions = <26 38>;
        };

        asterisk {
            bindings = <&kp ASTERISK>;
            key-positions = <27 39>;
        };

        left_parenthesis {
            bindings = <&kp LEFT_PARENTHESIS>;
            key-positions = <28 40>;
        };

        right_parenthesis {
            bindings = <&kp RIGHT_PARENTHESIS>;
            key-positions = <29 41>;
        };

        smartnum {
            bindings = <SMART_NUM>;
            key-positions = <52 53>;
        };

        i-projectv-view {
            bindings = <&kp LA(NUMBER_1)>;
            key-positions = <18 20>;
        };

        i-m-project-view {
            bindings = <&kp LG(NUMBER_1)>;
            key-positions = <18 20>;
            layers = <1>;
        };

        page-up {
            bindings = <&kp PAGE_UP>;
            key-positions = <20 19>;
        };

        page-down {
            bindings = <&kp PAGE_DOWN>;
            key-positions = <20 21>;
        };

        i-create-items {
            bindings = <&kp LA(INS)>;
            key-positions = <21 22>;
        };

        i-m-insert-items {
            bindings = <&kp LG(N)>;
            key-positions = <21 22>;
            layers = <1>;
        };

        j {
            bindings = <&kp J>;
            key-positions = <30 32>;
        };

        enter-2 {
            bindings = <&kp ENTER>;
            key-positions = <32 31>;
        };

        esc-1 {
            bindings = <&kp ESCAPE>;
            key-positions = <32 33>;
        };

        del {
            bindings = <&kp DEL>;
            key-positions = <33 34>;
        };

        home {
            bindings = <&kp HOME>;
            key-positions = <43 44>;
        };

        end {
            bindings = <&kp END>;
            key-positions = <44 45>;
        };

        insert {
            bindings = <&kp INSERT>;
            key-positions = <45 46>;
        };

        home-2 {
            bindings = <&kp LC(A)>;
            key-positions = <54 55>;
        };

        thumb_1 {
            bindings = <&caps_word>;
            key-positions = <61 58>;
        };

        thumb_2 {
            bindings = <&none>;
            key-positions = <60 59>;
        };

        thumb_3 {
            bindings = <SMART_NUM>;
            key-positions = <62 65>;
        };

        thumb_4 {
            bindings = <&none>;
            key-positions = <63 64>;
        };
        equal {
            bindings = <&kp EQUAL>;
            key-positions = <20 32>;
        };

        negative {
            bindings = <&kp MINUS>;
            key-positions = <19 31>;
        };

        splash {
            bindings = <&kp BSLH>;
            key-positions = <21 33>;
        };

        back_slash {
            bindings = <&kp FSLH>;
            key-positions = <33 45>;
        };

        idk_1 {
            bindings = <&kp LEFT_BRACKET>;
            key-positions = <31 43>;
        };

        idk_2 {
            bindings = <&kp RIGHT_BRACKET>;
            key-positions = <44 32>;
        };

        idk_3 {
            bindings = <&kp TILDE>;
            key-positions = <30 42>;
        };
        m-copy {
            bindings = <&kp LG(C)>;
            key-positions = <38 39>;
            layers = <1>;
        };

        m-paste {
            bindings = <&kp LG(V)>;
            key-positions = <39 40>;
            layers = <1>;
        };
    };

    macros {
        insertOrg: insertOrg {
            compatible = "zmk,behavior-macro";
            #binding-cells = <0>;
            bindings = <&kp SPACE &kp N &kp R &kp I>;
            label = "INSERTORG";
        };

        insertOrgFind: insertOrgFind {
            compatible = "zmk,behavior-macro";
            #binding-cells = <0>;
            bindings = <&kp SPACE &kp N &kp R &kp F>;
            label = "INSERTORGFIND";
        };

        insertLink: insertLink {
            compatible = "zmk,behavior-macro";
            #binding-cells = <0>;
            bindings = <&kp SPACE &kp I &kp L>;
            label = "INSERTLINK";
        };

        e_list_buffer: e_list_buffer {
            compatible = "zmk,behavior-macro";
            #binding-cells = <0>;
            bindings = <&kp SPACE &kp B &kp I>;
            label = "E_LIST_BUFFER";
        };

        i_find_all: i_find_all {
            compatible = "zmk,behavior-macro";
            #binding-cells = <0>;
            bindings = <&kp RCTRL &kp B &kp I>;
            label = "I_FIND_ALL";
        };
    };

    keymap {
        compatible = "zmk,keymap";

        Base {
            // ---------------------------------------------------------------------------------------------------------------------------------
             // | UNLOCK |   1    |   2    |   3    |   4    |   5    |                                      |   6    |   7    |   8    |   9    |   0    | UNLOCK |
             // |   TO3  |   Q    |   W    |   F    |   P    |   B    |                                      |   J    |   L    |   U    |   Y    |   '    |  TO3   |
             // |   TO2  |  GUI+A | ALT+R  | SFT+S  | CTL+T  |   G    |                                      |   M    | CTL+N  | SFT+E  | ALT+I  | GUI+O  |  TO2   |
             // |   TO1  |   Z    |   X    |   C    |   D    |   V    |                                      |   K    |   H    |   ,    |   .    |   ;    |  TO1   |
             // |   (    |   )    |  UP    | DOWN   |        |         | BSPC   |                    |SPACE  |  LEFT  |                    | RIGHT |  [   |   ]    |  
             // |  CTRL  |  TOG3  |  TOG2  | ENTER  |  NUM   | MB4    |  TOG2  |                    | TOG3  |        |        |        |        |        |        |

            bindings = <
SMART_NUM  &kp N1        &kp N2       &kp N3        &kp N4        &kp N5     &kp N6    &kp N7        &kp N8        &kp N9       &kp N0       &caps_word
&kp ESC           &kp Q         &kp W        &kp F         &kp P         &kp B      &kp J     &kp L         &kp U         &kp Y        &kp SQT      &tog 1
&hml DELETE BSPC           &hml LGUI A   &hml LALT R  &hml LSHFT S  &hml LCTRL T  &kp G      &kp M     &hmr LCTRL N  &hmr RSHFT E  &hmr LALT I  &hmr LGUI O  &kp ENTER
&tog 3           &kp Z         &kp X        &kp C         &kp D         &kp V      &kp K     &kp H         &kp COMMA     &kp DOT      &kp SEMI     &tog 3
&kp LC(BSPC)    &kp BSPC  &kp UP       &kp DOWN      &kp BSPC      &kp SPACE  &kp LEFT  &kp RIGHT     &kp ENTER      &kp LC(ENTER)
&mkp MB4        &kp ESC       &tog 3      &kp ENTER     SMART_NUM      &tog 3     &kp ESC   &mkp MB5
            >;

            label = "Base";
        };

        Mac {
            bindings = <
SMART_NUM  &kp N1        &kp N2       &kp N3        &kp N4        &kp N5     &kp N6    &kp N7        &kp N8        &kp N9       &kp N0       &caps_word
&kp ESC           &kp Q         &kp W        &kp F         &kp P         &kp B      &kp J     &kp L         &kp U         &kp Y        &kp SQT      &tog 1
&hml DELETE BSPC           &kp A   &hml LCTRL R  &hml LALT S  &hml LCMD T  &kp G      &kp M     &hmr LCTRL N  &hmr RSHFT E  &hmr LALT I  &hmr LGUI O  &kp ENTER
&tog 3           &kp Z         &kp X        &kp C         &kp D         &kp V      &kp K     &kp H         &kp COMMA     &kp DOT      &kp SEMI     &tog 3
&kp LC(BSPC)    &kp BSPC  &kp UP       &kp DOWN      &kp BSPC      &kp SPACE  &kp LEFT  &kp RIGHT     &kp ENTER      &kp LC(ENTER)
&mkp MB4        &kp ESC       &tog 3      &kp ENTER     SMART_NUM      &tog 3     &kp ESC   &mkp MB5
            >;

            label = "MAC";
        };

        NUM {
            bindings = <
&trans  &trans  &trans  &trans  &trans  &trans  &trans  &trans  &trans  &trans  &trans  &trans
&trans  &kp N1  &kp N2  &kp N3  &kp N4  &kp N5  &trans  &trans  &trans  &trans  &trans  &trans
&trans  &kp N6  &kp N7  &kp N8  &kp N9  &kp N0  &trans  &trans  &trans  &trans  &trans  &trans
&trans  &trans  &trans  &trans  &trans  &trans  &trans  &trans  &trans  &trans  &trans  &trans
&trans  &trans  &trans  &trans  &trans  &tog 2  &trans  &trans  &trans  &trans
&trans  &trans  &trans  &trans  &trans  &trans  &trans  &trans
            >;
            label = "NUMBER";
        };

        func {
            bindings = <
&trans           &trans           &trans           &trans           &trans  &trans   &trans           &trans             &trans           &trans           &trans            &trans
&out OUT_TOG     &kp F1           &kp F2           &kp F3           &kp F4  &kp F5   &bt BT_SEL 0     &bt BT_SEL 1       &bt BT_SEL 2     &bt BT_SEL 3     &bt BT_SEL 4      &trans
&bootloader      &kp F6           &kp F7           &kp F8           &kp F9  &kp F10  &rgb_ug RGB_TOG  &kp K_VOLUME_DOWN  &kp C_VOLUME_UP  &kp K_MUTE       &kp K_PLAY_PAUSE  &bootloader
&trans           &kp F11          &kp F12           &trans           &trans  &trans  &trans           &trans             &trans           &trans           &trans            &trans
&rgb_ug RGB_SPD  &rgb_ug RGB_SPI  &rgb_ug RGB_BRD  &rgb_ug RGB_BRD  &tog 3   &tog 3   &rgb_ug RGB_HUD  &rgb_ug RGB_HUI    &rgb_ug RGB_EFR  &rgb_ug RGB_EFF
&trans           &trans           &trans           &trans           &trans  &trans   &trans           &trans
            >;

            label = "FUNC";
        };

        mouse {
            bindings = <
&trans    &trans    &trans     &trans     &trans     &trans  &trans  &trans  &trans  &trans  &trans  &trans
&trans    &trans    &trans     &trans     &trans     &trans  &trans  &trans  &trans  &trans  &trans  &trans
&trans    &trans    &trans     &trans     &trans     &trans  &trans  &trans  &trans  &trans  &trans  &trans
&trans    &trans    &trans     &trans     &trans     &trans  &trans  &trans  &trans  &trans  &trans  &trans
&trans    &trans    &trans     &trans     &mkp LCLK  &trans  &trans  &trans  &trans  &trans
&mkp MB4  &mkp MB5  &mkp MCLK  &mkp RCLK  &trans     &trans  &trans  &trans
            >;

            label = "MOUSE";
        };
    };

    conditional_layers {
        compatible = "zmk,conditional-layers";

        test {
            if-layers = <0>;
            then-layer = <0>;
        };
    };
};

//right hand trackball override
