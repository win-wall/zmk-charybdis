## config/west.yml
```yaml
manifest:
  remotes:
  - name: zmkfirmware
    url-base: https://github.com/zmkfirmware
  - name: badjeff
    url-base: https://github.com/badjeff
  - name: Cyboard-DigitalTailor
    url-base: https://github.com/Cyboard-DigitalTailor
  - name: mctechnology17
    url-base: https://github.com/mctechnology17
  - name: kevinpastor
    url-base: https://github.com/kevinpastor
  - name: englmaxi
    url-base: https://github.com/englmaxi
  - name: carrefinho                            # <--- add this
    url-base: https://github.com/carrefinho
  - name: win-wall
    url-base: https://github.com/win-wall
  - name: urob
  url-base: https://github.com/urob
  projects:
  - name: zmk
    remote: zmkfirmware
    revision: main
    import: app/west.yml
  - name: zmk-pmw3610-driver
    remote: badjeff
    revision: main
  - name: zmk-oled-adapter
    remote: mctechnology17
    revision: main
  - name: zmk-nice-oled
    remote: mctechnology17
    revision: main
  - name: prospector-zmk-module                 # <--- and these
    remote: carrefinho                          # <---
    revision: main
  - name: zmk-helpers
    remote: win-wall
    revision: main
  - name: zmk-auto-layer
    remote: urob
    revision: main
```
