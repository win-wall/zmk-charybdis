#include <dt-bindings/zmk/input_transform.h>
#include <input/processors.dtsi>

 / {
    split_inputs {
        status = "okay";
        #address-cells = <1>;
        #size-cells = <0>;

        trackball_split_0: trackball_split_0@0 {
            compatible = "zmk,input-split";
            reg = <0>;
        };
    };

    trackball_peripheral_listener: trackball_peripheral_listener {
        compatible = "zmk,input-listener";
        status = "disabled";
        device = <&trackball_split_0>;
    };
 };