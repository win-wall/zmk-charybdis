#include <dt-bindings/zmk/input_transform.h>
#include <input/processors.dtsi>

 / {
    split_inputs_1 {
        status = "okay";
        #address-cells = <1>;
        #size-cells = <0>;
        trackball_split_1: trackball_split_1@1 {
            compatible = "zmk,input-split";
            reg = <1>;
        };
    };
    //right hand trackball
    trackball_central_listener: trackball_central_listener {
        compatible = "zmk,input-listener";
        status = "disabled";
        device = <&trackball_split_1>;
    };
 };